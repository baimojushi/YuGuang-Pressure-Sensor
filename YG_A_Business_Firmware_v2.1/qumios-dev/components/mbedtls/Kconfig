## YG_B_Sensing_Firmware_v2.1/main/Kconfig.projbuild
```kconfig
menu "Yuguang BLE"
config YG_BLE_UNENCRYPTED_DEBUG
    bool "Allow unencrypted fixed-peer BLE debugging (unsafe)"
    default n
    help
        Skip pairing and bonding only for the Yuguang fixed-peer link.
        Data is not confidential and MAC addresses can be spoofed.
        Both boards must use the same mode. Disable for production.
endmenu
```

## YG_Local_LAN_v3/sensor_esp32s3/main/Kconfig.projbuild
```kconfig
menu "YG Local LAN Sensor"
    config YG_WIFI_SSID
        string "2.4 GHz Wi-Fi SSID"
        default "REPLACE_ME"
    config YG_WIFI_PASSWORD
        string "Wi-Fi password (stored in firmware; keep sdkconfig private)"
        default "REPLACE_ME"
    config YG_SERVER_URL
        string "PC LAN POST URL (never public Internet)"
        default "http://192.168.1.100:8000/v1/ingest"
    config YG_DEVICE_ID
        string "Device ID"
        default "sensor01"
    config YG_DEVICE_TOKEN
        string "Device token (must equal PC config; keep secret)"
        default "REPLACE_WITH_RANDOM_TOKEN"
    config YG_UPLOAD_INTERVAL_MS
        int "Image + radar upload interval ms"
        default 1000
        range 200 5000
    config YG_SERVO_GPIO
        int "Servo PWM GPIO (default 48, not camera CS GPIO4)"
        default 48
        range 0 48
    config YG_SERVO_MIN_DEG
        int "Servo physical safe minimum angle"
        default 30
        range 0 90
    config YG_SERVO_MAX_DEG
        int "Servo physical safe maximum angle"
        default 150
        range 90 180
    config YG_SERVO_HOME_DEG
        int "Servo home angle"
        default 90
        range 30 150
endmenu
```

## YG_Local_LAN_v3/sensor_esp32s3/sdkconfig.defaults
```kconfig
CONFIG_IDF_TARGET="esp32s3"
CONFIG_ESPTOOLPY_FLASHSIZE_16MB=y
CONFIG_ESPTOOLPY_FLASHSIZE="16MB"
CONFIG_FREERTOS_HZ=1000
CONFIG_PARTITION_TABLE_CUSTOM=y
CONFIG_PARTITION_TABLE_CUSTOM_FILENAME="partitions.csv"
CONFIG_SPIRAM=y
CONFIG_SPIRAM_MODE_OCT=y
CONFIG_SPIRAM_SPEED_120M=y
CONFIG_SPIRAM_USE_MALLOC=y
CONFIG_SPIRAM_MALLOC_ALWAYSINTERNAL=0
CONFIG_FREERTOS_TASK_CREATE_ALLOW_EXT_MEM=y
CONFIG_ESP_VIDEO_ENABLE_SPI_VIDEO_DEVICE=y
CONFIG_ESP_VIDEO_ENABLE_DATA_PREPROCESSING=y
CONFIG_ESP_VIDEO_CHECK_PARAMETERS=y
CONFIG_CAMERA_BF3901=y
CONFIG_CAMERA_BF3901_AUTO_DETECT_SPI_INTERFACE_SENSOR=y
CONFIG_CAMERA_BF3901_SPI_YUV422_240X320_12FPS=y
CONFIG_CAMERA_BF3901_SPI_DEFAULT_FMT_YUV422_240X320_12FPS=y
CONFIG_CAMERA_BF3901_SPI_IF_FORMAT_INDEX_DEFAULT=2
CONFIG_CAMERA_SENSOR_XCLK_INPUT_24M=y
CONFIG_CAMERA_XCLK_USE_LEDC=y
# This firmware has no coco_pose, BLE, agent, cloud or MQTT partition.

# --- YG Local LAN v3 sensor: network target ---
CONFIG_YG_WIFI_SSID="“root”的 iPhone12"
CONFIG_YG_WIFI_PASSWORD="87654321"
CONFIG_YG_SERVER_URL="http://172.20.10.2:8000/v1/ingest"
CONFIG_YG_DEVICE_ID="sensor01"
CONFIG_YG_DEVICE_TOKEN="vvCAbsWM0B9mcXNdcKfunaNUwXLckVSDc_-Gvwpf5k"
CONFIG_YG_UPLOAD_INTERVAL_MS=1000
CONFIG_YG_SERVO_GPIO=48
CONFIG_YG_SERVO_MIN_DEG=30
CONFIG_YG_SERVO_MAX_DEG=150
CONFIG_YG_SERVO_HOME_DEG=90
```
